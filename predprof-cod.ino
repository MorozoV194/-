#include <Stepper.h> // Подключение библиотеки для работы с ШД 
///////////////////////////////////////////////////////////////////////////////////////////////////////////////////////////////////////////////////////////////////////////////////////////////////
#include <GyverOLED.h>  ///////////////////////////////////////////////////////////////////////////////////////////////////
///////////////////////////////////////////////////////////////////////////////////////////////////////////////////////////////////////////////////////////////////////////////////////////////////

///////////////////////////////////////////////////////////////////////////////////////////////////////////////////////////////////////////////////////////////////////////////////////////////////
#define steps 200 // Количество шагов на оборот
#define oneshift 2 // Количество шагов на одно движение 
#define Waiting 333 // Ожиданине в миллисекундах
#define Lineika 350 // Ожиданине в миллисекундах
#define FotoPorog 1010 // Порог яркости читаемого фотодиода
#define Scale 786 // Масштаб - мкм/шаг

///////////////////////////////////////////////////////////////////////////////////////////////////////////////////////////////////////////////////////////////////////////////////////////////////
///////////////////////////////////////////////////////////////////////////////////////////////////////////////////////////////////////////////////////////////////////////////////////////////////
GyverOLED<SSD1306_128x64, OLED_NO_BUFFER> oled;
const uint8_t bitmap_32x32[] PROGMEM = {
  0x00, 0x00, 0x00, 0x00, 0x00, 0x80, 0xC0, 0xC0, 0xE0, 0xF0, 0x70, 0x70, 0x30, 0x30, 0x30, 0x20, 0x00, 0x00, 0x00, 0x00, 0x00, 0x00, 0xC0, 0xE0, 0xF0, 0xF0, 0x70, 0x30, 0x30, 0x20, 0x00, 0x00,
  0x00, 0x30, 0x78, 0xFC, 0x7F, 0x3F, 0x0F, 0x0F, 0x1F, 0x3C, 0x78, 0xF0, 0xE0, 0xC0, 0x80, 0x80, 0x80, 0x40, 0xE0, 0xF0, 0xF8, 0xFC, 0xFF, 0x7F, 0x33, 0x13, 0x1E, 0x1C, 0x1C, 0x0E, 0x07, 0x00,
  0x00, 0x00, 0x00, 0x00, 0x00, 0x00, 0x00, 0x00, 0x80, 0xC0, 0xE0, 0xF0, 0xF9, 0xF7, 0xEF, 0x5F, 0x3F, 0x7F, 0xFE, 0xFD, 0xFB, 0xF1, 0xE0, 0xC0, 0x80, 0x00, 0x00, 0x00, 0x00, 0x00, 0x00, 0x00,
  0x00, 0x00, 0x00, 0x00, 0x00, 0x0C, 0x1E, 0x33, 0x33, 0x1F, 0x0F, 0x07, 0x03, 0x01, 0x00, 0x00, 0x00, 0x00, 0x00, 0x01, 0x03, 0x07, 0x0F, 0x1F, 0x3F, 0x1F, 0x0E, 0x04, 0x00, 0x00, 0x00, 0x00,
};
///////////////////////////////////////////////////////////////////////////////////////////////////////////////////////////////////////////////////////////////////////////////////////////////////
///////////////////////////////////////////////////////////////////////////////////////////////////////////////////////////////////////////////////////////////////////////////////////////////////


// Создание экземпляра класса для работы с ШД. казываем кол-во шагов на один оборот 
// и пины Arduino, к которым подключены обмотки двигатедя 

int position1, position2;    // текущее положение в шагах // Начальная установка - крайнее левое положение (ставим вручную)
int flag;
int FotoPin = analogRead(A0);
int WideST, WideMM;
long WideMKM;
int temno; // порог для фотодиода - отсутствие засветки

float C_h=0.3; // мм
float C_l=1.0; // м
int C_n=15;     //число максимумов
int Lam;       // длина волны нм

Stepper myStepper(steps, 7, 6, 5, 4); 


void setup() { 
	
///////////////////////////////////////////////////////////////////////////////////////////////////////////////////////////////////////////////////////////////////////////////////////////////////
  Serial.begin(9600);
  oled.init();  // инициализация
  oled.clear();   // очистить дисплей (или буфер)
  //oled.update();  // обновить. Только для режима с буфером! OLED_BUFFER
  oled.setScale(1);
  char *buff;

  buff="START!";
  oled.println(buff);
///////////////////////////////////////////////////////////////////////////////////////////////////////////////////////////////////////////////////////////////////////////////////////////////////

    myStepper.setSpeed(5); // Устанавливаем скорость вращения об./мин. 
    flag=0;
    position1=0; 
 
  while (flag==0) {
    myStepper.step(oneshift); // Вращаем двигатель ВПРАВО на "steps" шагов 
	  delay(Waiting); // Ждём "Waiting" миллисекунд
    position1 = position1 + oneshift;
	  temno=analogRead(FotoPin); // читаем  яркость на фотодиоде
   // sprintf(buff, "temno: %d steps", temno);
  //oled.print(buff);
    //oled.println(" ");
    if (temno < FotoPorog) {flag=1;} // проверка порога яркости, темно - продолжаем движение
  // ярко - движемся в конец линейки продолжаем движение
    }
  

///////////////////////////////////////////////////////////////////////////////////////////////////////////////////////////////////////////////////////////////////////////////////////////////////
sprintf(buff, "LEFT : %d steps", position1);
oled.print(buff);
oled.println(" ");
///////////////////////////////////////////////////////////////////////////////////////////////////////////////////////////////////////////////////////////////////////////////////////////////////

 myStepper.setSpeed(60); // Устанавливаем скорость вращения об./мин. 
  delay(2000); // Ждём  1 сек
	 myStepper.step(Lineika-position1); // перемещаем в конец линейки 
  delay(2000); // Ждём  1 сек
	  

 myStepper.setSpeed(5); // Устанавливаем скорость вращения об./мин. 
   flag=0;
  position2=Lineika; 
   while (flag==0) {
    myStepper.step(-oneshift); // Вращаем двигатель в ВЛЕВО на "steps" шагов 
	  delay(Waiting); // Ждём "Waiting" миллисекунд
    position2 =position2-oneshift;
	  temno=analogRead(FotoPin); // читаем  яркость на фотодиоде
    //sprintf(buff, "temno: %d steps", temno);
    //oled.print(buff);
    //oled.println(" ");
    if (temno<FotoPorog)  {flag=1;} // проверка порога яркости, темно - продолжаем движение
    }
  
  
  WideST=position2-position1;
  WideMM=int(float(WideST)*Scale/1000);
  


///////////////////////////////////////////////////////////////////////////////////////////////////////////////////////////////////////////////////////////////////////////////////////////////////
sprintf(buff, "RIGHT: %d steps", position2);
oled.print(buff);
oled.println(" ");
sprintf(buff, "WIDE : %d steps", WideST);
oled.print(buff);
oled.println(" ");
sprintf(buff, "WIDE : %d мм", WideMM);
oled.print(buff);
oled.println(" ");
///////////////////////////////////////////////////////////////////////////////////////////////////////////////////////////////////////////////////////////////////////////////////////////////////
  
Lam=int(float(WideMM)*C_h*1000/2/C_l/float(C_n));
sprintf(buff, "WaveLen: %d нм", Lam);
oled.print(buff);
oled.println(" ");

  
  
  } 
	
void loop() { 

	
	}
	
	
	